## code/rpi5/kernel/new/vendor/lechao/LcIod/Kconfig
```kconfig
config VENDOR_LECHAO_USBD
	bool "Lechao USB Storage Rate Monitor"
	depends on VENDOR_LECHAO
	depends on USB_STORAGE=y
	depends on USB_UAS=y
	select LCVIEW
	default y
	help
	  Monitor transfer rates for USB mass-storage devices.
	  Provides per-device statistics via character devices named
	  /dev/vendor_lechao_usbdN (N = 0..15).

config VENDOR_LECHAO_SD_MON
	bool "Lechao SD/MMC block-layer health monitor"
	depends on VENDOR_LECHAO
	depends on LCVIEW
	depends on MMC_BLOCK=y
	default y
	help
	  Monitor SD/MMC block-layer health: aggregate transfer
	  bytes/requests over a 10s window and, on card-busy stuck,
	  progressively strip SD bus-speed caps to downgrade the card.
	  Events are reported via LcView; enable knob and counters are
	  exposed under /sys/class/lciod_sd/lciod_sd.
```

## patchs/rpi5/kernel/modified/Kconfig.diff
```kconfig
diff --git a/Kconfig b/Kconfig
index 57a142d8d8b4..f51a39c7e2f9 100644
--- a/Kconfig
+++ b/Kconfig
@@ -19,6 +19,8 @@ source "net/Kconfig"
 
 source "drivers/Kconfig"
 
+source "vendor/Kconfig"
+
 source "fs/Kconfig"
 
 source "security/Kconfig"
```

## patchs/rpi5/kernel/new/vendor/lechao/LcIod/Kconfig
```kconfig
config VENDOR_LECHAO_USBD
	bool "Lechao USB Storage Rate Monitor"
	depends on USB_STORAGE
	select LCVIEW
	default y
	help
	  Monitor transfer rates for USB mass-storage devices.
	  Provides per-device statistics via character devices under
	  /dev/vendor_lechao_usbd/.
```

## patchs/rpi5/kernel/new/vendor/lechao/LcView/Kconfig
```kconfig
# SPDX-License-Identifier: GPL-2.0
#
# LcView 结构化事件日志子系统 Kconfig 配置
#
# 启用后编译 LcView 内核模块，提供：
#   1. Builder API（供内核其他模块调用，记录结构化事件）
#   2. 环形缓冲区（无锁写 + overflow eviction）
#   3. /dev/vendor_lechao_lcview 字符设备（供用户态读取）
#
# 依赖：CONFIG_VENDOR_LECHAO（父菜单选项）

config LCVIEW
    bool "LcView logging trace subsystem"
    help
      LcView is a structured event logging system for kernel modules.
      It provides a builder-style API for other kernel code to log
      events, stores them in a ring buffer, and exposes the data via
      /dev/vendor_lechao_lcview character device.

      If unsure, say N.
```
